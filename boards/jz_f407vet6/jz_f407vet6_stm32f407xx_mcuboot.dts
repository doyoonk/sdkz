/*
 * Copyright (c) 2025 HU Inc.
 *
 * SPDX-License-Identifier: Apache-2.0
 */

 #include "jz_f407vet6_common.dtsi"

/ {
	model = "JZ STM32F407VET6 Development board";
	compatible = "jz,f407vet6-mcuboot";

	aliases {
		mcuboot-led0 = &red_led_1;
		mcuboot-button0 = &button0;
	};
};
