## boards/Kconfig
```kconfig
# SPDX-License-Identifier: Apache-2.0

# There might not be any board options, hence the optional source
osource "$(KCONFIG_BOARD_DIR)/Kconfig"
```

## boards/jz/jz_f407vet6/board.yml
```yaml
#
# Copyright (c) 2025 HU Inc.
#
# SPDX-License-Identifier: Apache-2.0
#

board:
  name: jz_f407vet6
  full_name: JZ F407VET6 Development board
  vendor: jz
  socs:
    - name: stm32f407xx
      variants:
        - name: mcuboot
```

## boards/jz/jz_f407vet6/jz_f407vet6_defconfig
```kconfig
#
# Copyright (c) 2025 HU Inc.
#
# SPDX-License-Identifier: Apache-2.0
#

# Enable MPU
CONFIG_ARM_MPU=y

# Enable HW stack protection
CONFIG_HW_STACK_PROTECTION=y

# Enable UART
CONFIG_SERIAL=y

# console
CONFIG_CONSOLE=y
CONFIG_UART_CONSOLE=y

# enable GPIO
CONFIG_GPIO=y

# boot loader : for opspro_n6
CONFIG_BOOTLOADER_MCUBOOT=y
CONFIG_MCUBOOT_SIGNATURE_KEY_FILE="${WEST_TOPDIR}/etc/ssl/certs/mcuboot_sign-rsa-2048.pem"
CONFIG_MCUBOOT_GENERATE_CONFIRMED_IMAGE=y

# This snippet enables SEGGER SystemView RTT support with the tracing subsystem.
CONFIG_USE_SEGGER_RTT=y
#CONFIG_RTT_CONSOLE=y

# SystemView RTT Tracing Snippet (rtt-tracing)
#CONFIG_TRACING=y
#CONFIG_SEGGER_SYSTEMVIEW=y
#CONFIG_SEGGER_SYSTEMVIEW_BOOT_ENABLE=n
#CONFIG_SEGGER_SYSVIEW_POST_MORTEM_MODE=n

#CONFIG_DEBUG_OPTIMIZATIONS=y
#CONFIG_DEBUG_THREAD_INFO=y
```

## boards/jz/jz_f407vet6/jz_f407vet6_stm32f407xx_mcuboot_defconfig
```kconfig
#
# Copyright (c) 2025 HU Inc.
#
# SPDX-License-Identifier: Apache-2.0
#

# Enable MPU
CONFIG_ARM_MPU=y

# Enable HW stack protection
CONFIG_HW_STACK_PROTECTION=y

# Enable UART
CONFIG_SERIAL=y

# console
CONFIG_CONSOLE=y
CONFIG_UART_CONSOLE=y

# enable GPIO
CONFIG_GPIO=y

CONFIG_BBRAM=y
CONFIG_FLASH=y
CONFIG_SPI=y
CONFIG_SPI_NOR=y
CONFIG_SPI_NOR_SFDP_DEVICETREE=n

# FLASH
CONFIG_FLASH=y
CONFIG_FLASH_PAGE_LAYOUT=y
CONFIG_FLASH_MAP=y
CONFIG_MPU_ALLOW_FLASH_WRITE=y

CONFIG_BOOT_MAX_IMG_SECTORS=512
CONFIG_BOOT_UPGRADE_ONLY=n
CONFIG_BOOT_BANNER=y
CONFIG_MCUBOOT_LOG_LEVEL_OFF=y
CONFIG_LOG_DEFAULT_LEVEL=0
CONFIG_DEBUG=n
CONFIG_XIP=y
CONFIG_HEAP_MEM_POOL_SIZE=4096

CONFIG_MCUBOOT_SERIAL=n
CONFIG_MCUBOOT_INDICATION_LED=n
CONFIG_MCUBOOT_BOOTUTIL_LIB=y
CONFIG_BOOT_SERIAL_UART=n
CONFIG_BOOT_SERIAL_ENTRANCE_GPIO=n
CONFIG_BOOT_SERIAL_CDC_ACM=n

CONFIG_MULTITHREADING=y
CONFIG_PICOLIBC=y
CONFIG_MCUBOOT_LOG_LEVEL_OFF=n
CONFIG_LOG_DEFAULT_LEVEL=3

CONFIG_ENABLE_MGMT_PERUSER=n
CONFIG_BOOT_SERIAL_WAIT_FOR_DFU=n
#CONFIG_BOOT_SERIAL_WAIT_FOR_DFU_TIMEOUT=500

CONFIG_BOOT_SWAP_USING_SCRATCH=y

# Use the default MCUBoot PEM key file (BOOT_SIGNATURE_KEY_FILE)
CONFIG_BOOT_SIGNATURE_TYPE_RSA=y
CONFIG_BOOT_SIGNATURE_TYPE_RSA_LEN=2048
CONFIG_BOOT_SIGNATURE_KEY_FILE="${WEST_TOPDIR}/etc/ssl/certs/mcuboot_sign-rsa-2048.pem"

CONFIG_RETENTION=y						# - Enables retention system
CONFIG_RETAINED_MEM=y					# - Enables retained memory driver
CONFIG_RETAINED_MEM_ZEPHYR_RAM=y
CONFIG_BOOT_SHARE_DATA=y				# - Enables shared data
CONFIG_BOOT_SHARE_DATA_BOOTINFO=y		# - Enables boot information shared data type
CONFIG_BOOT_SHARE_BACKEND_RETENTION=y	# - Stores shared data using retention/blinfo subsystem

CONFIG_BOOT_MAX_IMG_SECTORS_AUTO=n
```

## boards/jz_f407ve_dvk/Kconfig.defconfig
```kconfig
#
# Copyright (c) 2025 HU Inc.
#
# SPDX-License-Identifier: Apache-2.0
#

if BOARD_JZ_F407VE_DVK

if NETWORKING

config NET_L2_ETHERNET
	default y

endif # NETWORKING

endif # BOARD_JZ_F407VE_DVK
```

## boards/jz_f407ve_dvk/Kconfig.jz_f407vet6
```kconfig
#
# Copyright (c) 2025 HU Inc.
#
# SPDX-License-Identifier: Apache-2.0
#

config BOARD_JZ_F407VE_DVK
	select SOC_STM32F407XE
```

## boards/jz_f407vet6/Kconfig.defconfig
```kconfig
#
# Copyright (c) 2025 HU Inc.
#
# SPDX-License-Identifier: Apache-2.0
#

if BOARD_JZ_F407VET6

if NETWORKING

config NET_L2_ETHERNET
	default y

endif # NETWORKING

endif # BOARD_JZ_F407VET6
```

## boards/jz_f407vet6/Kconfig.jz_f407vet6
```kconfig
#
# Copyright (c) 2025 HU Inc.
#
# SPDX-License-Identifier: Apache-2.0
#

config BOARD_JZ_F407VET6
	select SOC_STM32F407XE
```

## boards/jz_f407vet6/board.yml
```yaml
board:
  name: jz_f407vet6
  full_name: JZ F407VET6 Development board
  vendor: hm
  socs:
    - name: stm32f407xx
      variants:
        - name: mcuboot
```

## boards/jz_f407vet6/jz_f407vet6_defconfig
```kconfig
#
# Copyright (c) 2025 HU Inc.
#
# SPDX-License-Identifier: Apache-2.0
#

# Enable MPU
CONFIG_ARM_MPU=y

# Enable HW stack protection
CONFIG_HW_STACK_PROTECTION=y

# Enable UART
CONFIG_SERIAL=y

# console
CONFIG_CONSOLE=y
CONFIG_UART_CONSOLE=y

# enable GPIO
CONFIG_GPIO=y

# boot loader : for opspro_n6
CONFIG_BOOTLOADER_MCUBOOT=y
CONFIG_MCUBOOT_SIGNATURE_KEY_FILE="etc/ssl/certs/mcuboot_sign-rsa-2048.pem"
CONFIG_MCUBOOT_GENERATE_CONFIRMED_IMAGE=y
```

## boards/jz_f407vet6/jz_f407vet6_stm32f407xx_mcuboot_defconfig
```kconfig
#
# Copyright (c) 2025 HU Inc.
#
# SPDX-License-Identifier: Apache-2.0
#

# Enable MPU
CONFIG_ARM_MPU=y

# Enable HW stack protection
CONFIG_HW_STACK_PROTECTION=y

# Enable UART
CONFIG_SERIAL=y

# console
CONFIG_CONSOLE=n
CONFIG_UART_CONSOLE=n

# enable GPIO
CONFIG_GPIO=y

CONFIG_MCUBOOT_SERIAL=y
CONFIG_MCUBOOT_INDICATION_LED=y
CONFIG_MCUBOOT_BOOTUTIL_LIB=y
CONFIG_BOOT_SERIAL_UART=y
CONFIG_BOOT_SERIAL_ENTRANCE_GPIO=y
CONFIG_BOOT_SERIAL_CDC_ACM=n

CONFIG_MULTITHREADING=y
CONFIG_PICOLIBC=y
CONFIG_MCUBOOT_LOG_LEVEL_OFF=y
CONFIG_LOG_DEFAULT_LEVEL=0

CONFIG_ENABLE_MGMT_PERUSER=y
CONFIG_BOOT_SERIAL_WAIT_FOR_DFU=y
CONFIG_BOOT_SERIAL_WAIT_FOR_DFU_TIMEOUT=500

# Use the default MCUBoot PEM key file (BOOT_SIGNATURE_KEY_FILE)
CONFIG_BOOT_SIGNATURE_TYPE_RSA=y
CONFIG_BOOT_SIGNATURE_TYPE_RSA_LEN=2048
CONFIG_BOOT_SIGNATURE_KEY_FILE="../../etc/ssl/certs/mcuboot_sign-rsa-2048.pem"
```

## boards/stm32n657x_dk/Kconfig.stm32n657x_dk
```kconfig
#
# Copyright (c) 2024 STMicroelectronics
# Copyright (c) 2025 HU Inc.
#
# SPDX-License-Identifier: Apache-2.0
#

config BOARD_STM32N657X_DK
	select SOC_STM32N657XX
```

## boards/stm32n657x_dk/board.yml
```yaml
#
# Copyright (c) 2025 HU Inc.
#
# SPDX-License-Identifier: Apache-2.0
#

board:
  name: stm32n657x_dk
  full_name: STM32N657X-DK
  vendor: st
  socs:
    - name: stm32n657xx
      variants:
        - name: sb
        - name: fsbl
```

## boards/stm32n657x_dk/stm32n657x_dk_stm32n657xx_fsbl_defconfig
```kconfig
#
# Copyright (c) 2024 STMicroelectronics
# Copyright (c) 2025 HU Inc.
#
# SPDX-License-Identifier: Apache-2.0
#

# Enable UART driver
CONFIG_SERIAL=y

# Enable GPIO
CONFIG_GPIO=y

# Console
CONFIG_CONSOLE=n
CONFIG_UART_CONSOLE=n

# Enable MPU
CONFIG_ARM_MPU=y

# Enable HW stack protection
CONFIG_HW_STACK_PROTECTION=y

# No internal Flash
CONFIG_XIP=n

CONFIG_STM32_MEMMAP=n
CONFIG_BOOT_MAX_IMG_SECTORS_AUTO=n
CONFIG_BOOT_MAX_IMG_SECTORS=4096

CONFIG_MULTIPLE_EXECUTABLE_RAM_REGIONS=n

CONFIG_MCUBOOT_SERIAL=y
CONFIG_MCUBOOT_INDICATION_LED=y
CONFIG_MULTITHREADING=y

CONFIG_BOOT_SERIAL_UART=y
CONFIG_ENABLE_MGMT_PERUSER=y
CONFIG_BOOT_SERIAL_WAIT_FOR_DFU=y
CONFIG_BOOT_SERIAL_WAIT_FOR_DFU_TIMEOUT=500

# Use the default MCUBoot PEM key file (BOOT_SIGNATURE_KEY_FILE)
CONFIG_BOOT_SIGNATURE_TYPE_RSA=y
CONFIG_BOOT_SIGNATURE_TYPE_RSA_LEN=2048
CONFIG_BOOT_SIGNATURE_KEY_FILE="../../etc/ssl/certs/mcuboot_sign-rsa-2048.pem"
```

## boards/vendor/custom_plank/Kconfig.custom_plank
```kconfig
#
# Copyright (c) 2021 Nordic Semiconductor ASA
# Copyright (c) 2025 HU Inc.
#
# SPDX-License-Identifier: Apache-2.0
#

config BOARD_CUSTOM_PLANK
	select SOC_NRF52840_QIAA
```

## boards/vendor/custom_plank/board.yml
```yaml
#
# Copyright (c) 2024 Nordic Semiconductor ASA
# Copyright (c) 2025 HU Inc.
#
# SPDX-License-Identifier: Apache-2.0
#

board:
  name: custom_plank
  full_name: Custom Plank
  vendor: vendor
  socs:
    - name: nrf52840
```

## drivers/Kconfig
```kconfig
#
# Copyright (c) 2021 Nordic Semiconductor ASA
# Copyright (c) 2025 HU Inc.
#
# SPDX-License-Identifier: Apache-2.0
#

menu "Drivers"
rsource "blink/Kconfig"
rsource "sensor/Kconfig"
endmenu
```

## lib/Kconfig
```kconfig
#
# Copyright (c) 2021 Legrand North America, LLC.
# Copyright (c) 2025 HU Inc.
#
# SPDX-License-Identifier: Apache-2.0
#

menu "Custom libraries"

rsource "custom/Kconfig"
rsource "net/Kconfig"
rsource "hu/Kconfig"

endmenu
```

## lib/hu/Kconfig
```kconfig
#
# Copyright (c) 2025 HU Inc.
#
# SPDX-License-Identifier: Apache-2.0
#

config HU
	bool "Support for HU library"
	help
	  This option enables the 'HU' library

mainmenu "HU library"

config HU_PACKET
	bool "Support HU packet"
	help
	  This option enables the 'HU' packet

config HU_PACKET_SIZE
	int "HU packet buffer size"
	default 1530
```

## modules/mcuboot/Kconfig
```kconfig
#
# Copyright (c) 2025 HU Inc.
#
# SPDX-License-Identifier: Apache-2.0
#

menu "MCUboot"

if BOOTLOADER_MCUBOOT
endif # BOOTLOADER_MCUBOOT

endmenu
```

## modules/mcuboot/boot/zephyr/Kconfig
```kconfig
#
# Copyright (c) 2025 HU Inc.
#
# SPDX-License-Identifier: Apache-2.0
#

# This file is sourced by the MCUboot sample Kconfig file
# See [mcuboot_dir]/boot/zephyr/Kconfig

config BOOT_USE_MIN_PARTITION_SIZE
	bool "Build for a minimal image size"

partition=MCUBOOT_SCRATCH

# disabled for reduce footprint
config BOOT_SERIAL_IMG_GRP_HASH
	bool
	default n

# disabled for reduce footprint
config BOOT_SERIAL_IMG_GPR_SLOT_INFO
	bool
	default n
```

## west.yml
```yaml
#
# Copyright (c) 2021 Nordic Semiconductor ASA
# Copyright (c) 2025 HU Inc.
#
# SPDX-License-Identifier: Apache-2.0
#
manifest:
  defaults:
    remote: upstream
  self:
    path: sdk
    west-commands: scripts/west-commands.yml
    import: submanifests

  remotes:
    - name: upstream
      url-base: https://github.com/zephyrproject-rtos
    - name: babblesim
      url-base: https://github.com/BabbleSim
    # https://github.com/bjarki-andreasen/zephyr-micropython/
    - name: bjarki-andreasen
      url-base: https://github.com/bjarki-andreasen

  group-filter: [-babblesim, -optional]

  projects:
    - name: zephyr
      remote: upstream
      revision: main
      import:
        # By using name-allowlist we can clone only the modules that are
        # strictly needed by the application.
        name-allowlist:
          - cmsis
          - cmsis-dsp
          - cmsis-nn
          - cmsis_6
          - hal_nxp
          - hal_st
          - hal_stm32
          - littlefs
          - lvgl
          - mbedtls
          - mcuboot
          - percepio
          - picolibc
          - segger
          - tf-psa-crypto
          - tinycrypt
          - zcbor

    - name: etc-data
      url: http://github.com/doyoonk/etcz.git
      revision: main
      path: etc

    - name: s2opc
      groups:
        - s2opc
      path: modules/lib/s2opc
      revision: master
      url: https://gitlab.com/systerel/S2OPC.git

    - name: micropython
      path: modules/lib/micropython
      revision: master
      url: https://github.com/micropython/micropython.git
      submodules: #true  # Automatically updates all submodules in this repo
        - path: lib/micropython-lib
    # https://github.com/bjarki-andreasen/zephyr-micropython/
    #- name: micropython
    #  remote: bjarki-andreasen
    #  revision: aceafd9e98151dd6f32ff142055947f0f32beeda
    #  path: modules/lib/micropython
    #  submodules:
    #    - path: lib/micropython-lib
```
