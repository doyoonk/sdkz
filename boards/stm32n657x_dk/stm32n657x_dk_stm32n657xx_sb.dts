/*
 * Copyright (c) 2025 STMicroelectronics
 * Copyright (c) 2025 HU Inc.
 *
 * SPDX-License-Identifier: Apache-2.0
 */

/dts-v1/;
#include "stm32n657x_dk_common.dtsi"

/ {
	model = "STMicroelectronics STM32N657X Discovery Kit board";
	compatible = "st,stm32n657x-dk-serial-boot";
};
