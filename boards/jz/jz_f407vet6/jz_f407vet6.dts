/*
 * Copyright (c) 2025 HU Inc.
 *
 * SPDX-License-Identifier: Apache-2.0
 */

 /dts-v1/;

#include "jz_f407vet6_common.dtsi"

/ {
	model = "JZ STM32F407VET6 Development board";
	compatible = "jz,f407vet6";

	pwmleds {
		compatible = "pwm-leds";
		status = "okay";

		pwm_led_0: pwm_led_0 {
			status = "okay";
			pwms = <&pwm1 3 PWM_MSEC(2000) PWM_POLARITY_NORMAL>;
			label = "PWM LED 0";
		};
	};

	aliases {
		rtc = &rtc;
		bbram = &bbram;
		led0 = &red_led_1;
		led1 = &red_led_2;
		sw0 = &button0;
		sw1 = &button1;
		sw2 = &button2;
		pwm-led0 = &pwm_led_0;
		die-temp0 = &die_temp;
		volt-sensor0 = &vref;
		volt-sensor1 = &vbat;
	};
};
