## drivers/memc/Kconfig
```kconfig
# Copyright (c) 2025 HU Inc. All rights reserved.
# SPDX-License-Identifier: Apache-2.0

config STM32N6_EXTRA_SRAM
	bool "STM32N6 AHB SRAM and video SRAM initialization"
	default y
	depends on SOC_SERIES_STM32N6X
	depends on DT_HAS_HU_STM32N6_EXTRA_SRAM_ENABLED
	depends on CLOCK_CONTROL
	help
	  Enable the clocks for AHBSRAM1/2 and VENCRAM. Release VENCRAM for
	  system use only when the VENC devicetree node is explicitly disabled.
	  Only controllers with an enabled memory child are initialized.

config STM32N6_SYSTEM_SRAM
	bool "STM32N6 CACHEAXI and VENCRAM system SRAM"
	default y if MCUBOOT
	depends on SOC_SERIES_STM32N6X
	depends on DT_HAS_ST_STM32N6_SYSTEM_SRAM_ENABLED
	help
	  Enable CACHEAXI RAM and release VENCRAM for system use without
	  erasing their contents. NPU, NPU cache and VENC must be disabled.
	  The bootloader must initialize these banks before loading or starting
	  an application that includes them in its primary RAM. Application
	  SYS_INIT callbacks run after stack and BSS accesses and cannot
	  provide cold-start support. The SDK supplies this initialization.
```

## drivers/sensor/stm32n6_dts/Kconfig
```kconfig
# SPDX-License-Identifier: Apache-2.0

config STM32N6_DTS
	bool "STM32N6 digital die temperature sensor"
	default y
	depends on SOC_SERIES_STM32N6X
	depends on DT_HAS_ST_STM32N6_DTS_ENABLED
	select USE_STM32_HAL_DTS
	help
	  Read one STM32N6 DTS sensor using the sensor API. Measurements use
	  12-bit single conversion with polling. The HSI clock must be enabled.

config STM32N6_DTS_TIMEOUT_MS
	int "STM32N6 DTS conversion timeout (ms)"
	depends on STM32N6_DTS
	range 1 1000
	default 100
	help
	  Maximum wait for a temperature conversion to complete.
```

## dts/bindings/memory-controllers/hu,stm32n6-extra-sram.yaml
```yaml
# Copyright (c) 2025 HU Inc. All rights reserved.
# SPDX-License-Identifier: Apache-2.0

description: |
  STM32N6 AHBSRAM1/2 and VENCRAM configuration. Unlike AXISRAM2-6, these
  banks do not use the AXISRAM power-down control. VENCRAM may be released
  to the system only when the VENC node is explicitly disabled.

compatible: "hu,stm32n6-extra-sram"

include: base.yaml

properties:
  reg:
    required: true
  clocks:
    required: true
    description: SRAM memory clock and RAMCFG controller clock.
  clock-names:
    required: true
    description: Names must be "sram" and "ramcfg".
  venc-shared:
    type: boolean
    description: This bank is shared with the VENC hardware.
```

## dts/bindings/memory-controllers/st,stm32n6-system-sram.yaml
```yaml
# Copyright (c) 2025 HU Inc. All rights reserved.
#
# SPDX-License-Identifier: Apache-2.0

description: |
  Reserve STM32N6 CACHEAXI RAM (256 KiB) and VENCRAM (128 KiB) for system
  SRAM. Enables their memory clocks and releases VENCRAM to the system,
  without resetting or erasing memory. CACHEAXI must already be disabled.
  NPU, NPU cache and VENC must remain disabled. The bootloader must include
  this initialization before loading or starting an application using
  these banks as primary RAM. This node creates no separate linker region.

compatible: "st,stm32n6-system-sram"

include: base.yaml
```

## dts/bindings/sensor/st,stm32n6-dts.yaml
```yaml
# SPDX-License-Identifier: Apache-2.0

description: |
  STM32N6 digital temperature sensor controller. One device exposes one
  selected sensing element through SENSOR_CHAN_DIE_TEMP. The controller
  must have a single owner; do not create separate nodes for its sensors.
  The fixed HSI / 8 kernel clock must be available. Polling is used, so
  an interrupt is not required.

compatible: "st,stm32n6-dts"

include: [sensor-device.yaml, base.yaml]

properties:
  reg:
    required: true
  clocks:
    required: true
  sensor-id:
    type: int
    default: 0
    enum: [0, 1]
    description: Sensing element to read; defaults to sensor 0.
```

## lib/app/Kconfig
```kconfig
#
# Copyright (c) 2021 Legrand North America, LLC.
# Copyright (c) 2025 HU Inc.
#
# SPDX-License-Identifier: Apache-2.0
#

config HU_APP
	bool "Support for HU APP library"
	help
	  This option enables the 'HU APP' library

if HU_APP

config HU_UDP_MAX_SESSIONS
	int "Maximum HU UDP sender sessions"
	depends on NET_L2_ETHERNET
	range 1 16
	default 4
	help
	  Keep separate HU parser state for each IPv4 address and UDP source port.
	  Parser buffers are allocated on first reception. When all sessions are
	  occupied, new senders are dropped until a session expires.

config HU_UDP_SESSION_TIMEOUT_MS
	int "HU UDP session idle timeout (milliseconds)"
	depends on NET_L2_ETHERNET
	range 1000 3600000
	default 30000
	help
	  Release idle sender sessions, including incomplete packets. A running
	  command is never expired; its idle timer restarts when processing ends.

source "samples/subsys/usb/common/Kconfig.sample_usbd"
source "samples/net/common/Kconfig"

endif # HU_APP
```

## modules/micropython/Kconfig
```kconfig
# Copyright (c) 2025 HU Inc. All rights reserved.
# SPDX-License-Identifier: Apache-2.0

config ZEPHYR_MICROPYTHON_MODULE
	bool

config MICROPYTHON
	bool "MicroPython"

config MICROPYTHON_STANDALONE
	bool "Run MicroPython as the standalone application"
	depends on MICROPYTHON
	help
	  Provide main() and run MicroPython on the Zephyr main thread.
	  The application must not provide another main(). Use micropy,console
	  when specified, otherwise use zephyr,console exclusively for the REPL.
	  Configure MAIN_STACK_SIZE for the interpreter's stack requirements.
	  When disabled, run on a separate thread with a dedicated micropy,console.

config MICROPYTHON_THREAD_STACK_SIZE
	int
	default 4736
	help
	  MicroPython thread stack size

rsource "port/Kconfig"
rsource "light/Kconfig"
```
