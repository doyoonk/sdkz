/*
 * Copyright (c) 2025 HU Inc.
 *
 * SPDX-License-Identifier: Apache-2.0
 */

#include <arm/armv8.1-m.dtsi>
#include <zephyr/dt-bindings/clock/stm32n6_clock.h>
#include <freq.h>

/ {
	soc {
		rtc: rtc@56004000 {
			compatible = "st,stm32-rtc";
			reg = <0x56004000 0x400>;
			// RTC_S_IRQn = 10, /*!< RTC secure interrupts through EXTI Line detection */
			// RTC_IRQn   = 16, /*!< RTC non-secure interrupts through EXTI Line detection */
			interrupts = <16 0>;
			clocks = <&rcc STM32_CLOCK_BUS_APB4 0x00030000>;
			prescaler = <32768>;
			alarms-count = <2>;
			alrm-exti-line = <17>;
			status = "disabled";

			bbram: backup_regs {
				compatible = "st,stm32-bbram";
				st,backup-regs = <32>;
				status = "disabled";
			};
		};
	};
};
