/*
 * Copyright (c) 2025 HU Inc. All rights reserved.
 *
 * SPDX-License-Identifier: Apache-2.0
 */

#include "stm32n6570_dk_app_common.dtsi"

/ {
	chosen {
		zephyr,sram = &axisramb;
	};
	aliases {
		mcuboot-led0 = &green_led_1;
		mcuboot-button0 = &user_button;
	};
};

&axisramb {
	status = "okay";
};
